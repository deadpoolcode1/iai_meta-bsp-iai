## conf/layer.conf
```bitbake
# We have a conf and classes directory, append to BBPATH
BBPATH .= ":${LAYERDIR}"

# We have a recipes directory, add to BBFILES
BBFILES += "${LAYERDIR}/recipes-*/*/*.bb \
            ${LAYERDIR}/recipes-*/*/*.bbappend"

BBFILE_COLLECTIONS += "meta-bsp-iai"
BBFILE_PATTERN_meta-bsp-iai := "^${LAYERDIR}/"
BBFILE_PRIORITY_meta-bsp-iai = "5"
LAYERSERIES_COMPAT_meta-bsp-iai = "kirkstone"

FILESEXTRAPATHS:prepend := "${LAYERDIR}/recipes-kernel/linux/files:"

CORE_IMAGE_EXTRA_INSTALL += " bridge-utils notes mdiotools version maintenance"
CORE_IMAGE_EXTRA_INSTALL += " stress rt-tests iperf3 netperf"
CORE_IMAGE_EXTRA_INSTALL += " openssh gdb gdbserver iptables"
LINUX_KERNEL_TYPE = "preempt-rt"
CORE_IMAGE_EXTRA_INSTALL += " tcpdump netsniff-ng ethtool"
CORE_IMAGE_EXTRA_INSTALL += " systemd-ethtool mtd-utils spidevtest jsoncpp jsoncpp-dev nano"
CORE_IMAGE_EXTRA_INSTALL += " i2c-tools"
CORE_IMAGE_EXTRA_INSTALL += " pytorch python3-numpy python3-pandas tensorflow-lite tensorflow-lite-vx-delegate"
TOOLCHAIN_TARGET_TASK:append = " jsoncpp-dev"
```
